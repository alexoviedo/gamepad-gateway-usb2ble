## Kconfig.projbuild
```kconfig
menu "Gamepad Gateway"

    config VERBOSE_HID_DEBUG
        bool "Verbose HID debug instrumentation"
        default n
        help
            Enables targeted instrumentation used to debug HID report decoding
            and multi-device merge behavior (e.g., the rudder axis issue).

            When enabled, the firmware will:
              - Dump a descriptor snapshot once per device connect
              - Track per-device report cadence and last report metadata
              - Print per-device decoded state before merging
              - Print per-axis merge "winner" device and collisions

            Keep this OFF for release builds to reduce log noise and overhead.

endmenu
```

## sdkconfig.defaults
```kconfig
# Generic ESP32-S3 configs
CONFIG_IDF_TARGET="esp32s3"

# Flash & PSRAM settings for ESP32-S3-WROOM-1-N16R8
CONFIG_ESPTOOLPY_FLASHSIZE_16MB=y
CONFIG_SPIRAM=y
CONFIG_SPIRAM_MODE_OCT=y
CONFIG_SPIRAM_SPEED_80M=y
# Alloc RAM automatically using spiram
CONFIG_SPIRAM_USE_MALLOC=y

# FreeRTOS settings (adjust Hz for better responsiveness)
CONFIG_FREERTOS_HZ=1000

# USB Host and Hub Support
CONFIG_USB_HOST_CONTROL_TRANSFER_MAX_SIZE=2048
# For max compat with hubs
CONFIG_USB_HOST_HW_BUFFER_BIAS_IN=y
CONFIG_USB_HOST_HUBS_SUPPORTED=y
CONFIG_USB_HOST_HUB_MULTI_LEVEL=y

# NimBLE for BLE Gamepad
CONFIG_BT_ENABLED=y
CONFIG_BT_NIMBLE_ENABLED=y
CONFIG_BT_NIMBLE_MAX_CONNECTIONS=1

# WiFi / HTTP for debug portal
CONFIG_ESP_WIFI_ENABLED=y

# Configure UART for console (prevents USB CDC from interfering with USB HOST)
# Disable USB CDC on boot, use UART0 for console
CONFIG_ESP_CONSOLE_UART_DEFAULT=y
CONFIG_ESP_CONSOLE_SECONDARY_NONE=y
CONFIG_PARTITION_TABLE_SINGLE_APP_LARGE=y
CONFIG_BT_NIMBLE_NVS_PERSIST=y
```
